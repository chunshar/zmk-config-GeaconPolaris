## config/west.yml
```yaml
manifest:
  remotes:
    - name: zmkfirmware
      url-base: https://github.com/zmkfirmware
    - name: te9no
      url-base: https://github.com/te9no
    - name: cormoran
      url-base: https://github.com/cormoran
  projects:
    - name: zmk
      # remote: zmkfirmware
      remote: te9no
      revision: v0.3-branch+dya
      import: app/west.yml
    - name: zmk-rgbled-widget
      url: https://github.com/caksoylar/zmk-rgbled-widget
      revision: v0.3
      path: modules/zmk-rgbled-widget
    - name: zmk-pmw3610-driver
      url: https://github.com/efogdev/zmk-pmw3610-driver
      revision: main
      path: modules/zmk-pmw3610-driver
    - name: zmk-analog-input-driver
      url: https://github.com/badjeff/zmk-analog-input-driver
      revision: main
      path: modules/zmk-analog-input-driver
    - name: zmk-nice-oled
      # remote: mctechnology17
      url: https://github.com/te9no/zmk-nice-oled
      revision: main
      path: modules/zmk-nice-oled
    - name: zmk-layout-shift
      revision: v1
      url: https://github.com/kot149/zmk-layout-shift
      path: modules/zmk-layout-shift
    - name: zmk-input-processor-keybind
      revision: main
      url: https://github.com/te9no/zmk-input-processor-keybind
      path: modules/zmk-input-processor-keybind
    # - name: cirque-input-module
    #   revision: main
    #   url: https://github.com/petejohanson/cirque-input-module
    #   path: modules/cirque-input-module
    - name: zmk-module-runtime-input-processor
      revision: main
      url: https://github.com/cormoran/zmk-module-runtime-input-processor
      path: modules/zmk-module-runtime-input-processor
    - name: zmk-module-ble-management
      revision: main
      url: https://github.com/cormoran/zmk-module-ble-management
      path: modules/zmk-module-ble-management
    - name: zmk-module-settings-rpc
      revision: main
      url: https://github.com/cormoran/zmk-module-settings-rpc
      path: modules/zmk-module-settings-rpc

    - name: zmk-module-cirque-trackpad
      revision: main
      url: https://github.com/te9no/zmk-module-cirque-trackpad
      path: modules/zmk-module-cirque-trackpad
    - name: zmk-module-analoginput-rpc
      revision: main
      url: https://github.com/te9no/zmk-module-analoginput-rpc
      path: modules/zmk-module-analoginput-rpc
    - name: zmk-module-battery-nrf-vddh-oversampling
      revision: main
      url: https://github.com/te9no/zmk-module-battery-nrf-vddh-oversampling
      path: modules/zmk-module-battery-nrf-vddh-oversampling
    # - name: zmk-feature-cdc-acm-bootloader-trigger
    #   revision: main
    #   url: https://github.com/cormoran/zmk-feature-cdc-acm-bootloader-trigger
    #   path: modules/zmk-feature-cdc-acm-bootloader-trigger
  self:
    path: config
    
```
