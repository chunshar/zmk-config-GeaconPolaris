#include <dt-bindings/zmk/bt.h>
#include <input/processors.dtsi>
#include <dt-bindings/zmk/input_transform.h>
#include <zephyr/dt-bindings/input/input-event-codes.h>
#include "Polaris.dtsi"
#include "Polaris_R_central_inputs.dtsi"

/ {
    kscan0: kscan0 {
        compatible = "zmk,kscan-gpio-charlieplex";
        interrupt-gpios = MATRIX_INTERRUPT_GPIOS;
        gpios
            = MATRIX_GPIOS
            ;
    };
};

&default_transform {
    col-offset = <6>;
};
